/* ============================================================
 * AXIS 内核链接脚本（高半核布局）
 * ============================================================
 * 定义内核的内存布局：低端引导桩 + 高半区内核主体
 *
 * 虚拟地址空间划分（与 boot.asm / config.rs 保持一致）：
 *   - 低端引导桩：虚拟地址 = 物理地址 = 0x100000
 *     （boot.asm 的 _boot 入口在此处运行，见下方"为什么"）
 *   - 高半区内核：虚拟地址 = 物理地址 + KERNEL_VIRT_BASE
 *     （真正的内核主体 .text/.rodata/.data/.bss 都链接在高半区）
 */

/* 输出格式：x86-64 架构 ELF */
OUTPUT_FORMAT(elf64-x86-64)

/* 入口点：_boot 符号（定义于 arch/x86_64/boot.asm）
 *
 * AXIS 内核使用 _boot 作为引导加载程序（BIOS Stage2 / UEFI）跳转的入口。
 * 该函数必须：
 *   1. 位于"虚拟地址 = 物理地址"的低端 .boot 段
 *      （Bootloader 以 ELF e_entry 直接跳转，此时高半区页表尚未建立）
 *   2. 负责建立高半核映射并绝对跳转到高半区（详见 boot.asm）
 *   3. 最终跳转到内核的 Rust 入口 _boot_rust
 */
ENTRY(_boot)

/* 内核虚拟地址基址：高半核地址空间 0xFFFFFFFF80000000
 *
 * 为什么必须使用高半核地址而不是恒等映射：
 *   - 将内核固定在高半区后，低端 4GB 虚拟地址空间可以完整留给用户态进程，
 *     SysV ABI 下用户程序的代码/数据/栈都能使用低端地址
 *   - 低端恒等映射只是引导期的临时手段（boot.asm 会在跳转后将其删除），
 *     作为最终布局的高半核地址才是内核的"家"
 */
KERNEL_VIRT_BASE = 0xFFFFFFFF80000000;

/* 内核物理地址基址：从 1MB 处开始加载 */
KERNEL_PHYS_BASE = 0x00100000;

/* ------------------------------------------------------------
 * 段（Sections）布局定义
 * ------------------------------------------------------------
 * 布局要点：低端只放引导桩，其余全部放入高半区。
 */
SECTIONS
{

    /* ========================================================
     * 低端引导桩段 .boot（虚拟地址 = 物理地址 = 0x100000）
     * ========================================================
     * 存放 boot.asm 的引导代码（_boot、init_page_tables）、临时页表
     * （PML4/PDPT/PD）和引导 GDT。
     *
     * 为什么不把引导桩也放进高半区：
     *   - Bootloader 在跳转时使用物理地址 e_entry（= 0x100000），
     *     且此刻高半区页表尚未建立，_boot 只能以低地址运行
     *   - 该段自带代码 + 数据 + 页表，需要可写可执行
     */
    . = KERNEL_PHYS_BASE;
    .boot : AT(KERNEL_PHYS_BASE)
    {
        *(.boot .boot.*)
    }

    /* ========================================================
     * 高半区内核主体（虚拟地址 = 物理地址 + KERNEL_VIRT_BASE）
     * ========================================================
     * 语法说明：先让位置计数器跨越高半区偏移，再定义各段。
     * 各段的 LMA（物理加载地址）= VMA（虚拟地址）- KERNEL_VIRT_BASE，
     * 保证 ELF 加载器仍能把内核连续加载到 0x100000 起的物理内存，
     * 与 boot.asm 建立的内核高半区页表（virt = phys + KERNEL_VIRT_BASE）对应。
     */
    . = ALIGN(4096);
    . += KERNEL_VIRT_BASE;

    /* ========================================================
     * .text - 代码段（只读、可执行）
     * ========================================================
     * 4KB 是 x86_64 的分页大小，对齐有利于内存管理和缓存效率
     * 包含 boot.asm 的高地址跳板（higher_half）与全部 Rust 代码
     * 
     * *(.text .text.*) 匹配所有 .text 开头的段：
     *   - .text 包含所有函数代码（Rust、汇编、内联汇编）
     *   - .text.* 匹配 LLVM 生成的带后缀的段
     *   - 后缀格式通常为 .text._ZN...（Rust 符号修饰）
     *   - 包括内核的所有执行代码
     * 
     * 注意：代码段在运行时是只读的，操作系统/内核必须保护它不被修改
     */
    . = ALIGN(4096);
    .text : AT(ADDR(.text) - KERNEL_VIRT_BASE)
    {
        *(.text .text.*)
    }

    /* ========================================================
     * .rodata - 只读数据段（只读、不可执行）
     * ========================================================
     * 存放常量数据：
     *   - 字符串字面量（"Hello, World!" 等）
     *   - 静态常量（const 变量）
     *   - 虚表（vtable，用于 trait 对象的动态分发）
     *   - 编译时确定的查找表（如 Unicode 映射表）
     *   - 内核的 GDT/IDT 描述符等只读数据结构
     * 
     * 对齐到 4KB 边界：
     *   - 与分页大小保持一致
     *   - 便于 MMU 设置只读权限（整个页只读）
     * 
     * 安全性考虑：
     *   - 该段在运行时不可修改，防止代码注入或数据篡改
     *   - 内核应尽量将常量数据放在只读区域
     */
    . = ALIGN(4096);
    .rodata : AT(ADDR(.rodata) - KERNEL_VIRT_BASE)
    {
        *(.rodata .rodata.*)
    }

    /* ========================================================
     * .data - 已初始化数据段（可读写）
     * ========================================================
     * 存放已初始化的全局变量和静态变量：
     *   - 静态变量（static mut 或 static 有初始值）
     *   - 全局分配器（allocator）的元数据
     *   - 内核配置参数（如启动参数、硬件配置）
     *   - 设备驱动中的状态变量
     * 
     * 该段在二进制文件中占用空间：
     *   - 初始值直接嵌入在 ELF 文件中
     *   - 由引导程序或加载器复制到内存指定位置
     *   - 运行时可以读写修改
     * 
     * 对齐到 4KB 边界便于内存管理
     */
    . = ALIGN(4096);
    .data : AT(ADDR(.data) - KERNEL_VIRT_BASE)
    {
        *(.data .data.*)
    }

    /* ========================================================
     * .bss - 未初始化数据段（可读写，初始值为零）
     * ========================================================
     * 存放未初始化的全局/静态变量，以及引导栈（boot.asm）。
     * 二进制文件中不占用存储空间，由 Bootloader 加载器清零；
     * boot.asm 的高地址跳板会再清一次以保证幂等。
     *
     * __bss_start / __bss_end 供 boot.asm 清零 BSS 使用。
     */
    . = ALIGN(4096);
    .bss : AT(ADDR(.bss) - KERNEL_VIRT_BASE)
    {
        __bss_start = .;          /* 虚拟地址 */
        *(.bss .bss.*)
        *(COMMON)
        __bss_end = .;            /* 虚拟地址 */
    }

    /* ========================================================
     * /DISCARD/ - 丢弃不需要的段
     * ========================================================
     * 这些段在最终二进制文件中被完全移除，不占用空间
     * 
     * .eh_frame: Rust 裸机环境不使用异常展开（panic = abort）
     * .comment/.note*: 编译器注释与 ELF 注释段，与运行无关
     */
    /DISCARD/ :
    {
        *(.eh_frame)
        *(.comment)
        *(.note*)
    }
}

/* 内核映像的物理末端地址
 *
 * 为什么需要导出这个符号：
 *   - boot.asm 需要按内核映像的实际大小建立高半区页表
 *   - __bss_end 是高半区虚拟地址，减去 KERNEL_VIRT_BASE 即得物理末端，
 *     由链接器在此一次性算好，供汇编以绝对地址引用
 */
__kernel_phys_end = __bss_end - KERNEL_VIRT_BASE;
