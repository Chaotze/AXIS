/* ============================================================
 * 链接器脚本 - AXIS Kernel 内存布局
 * ============================================================
 * 该文件定义了 AXIS 内核各段在内存中的位置和排列顺序
 * 由 build.rs 在编译时通过 -T 参数传递给 rustc 链接器（ld）
 * 适用平台：x86_64-axis（即 x86_64-unknown-none，裸机）
 *
 * 与通用引导程序链接器脚本的区别：
 *   - 本节名称更简洁（.boot 替代 .multiboot_header）
 *   - 专为 AXIS 微内核设计，强调最小化和精确控制
 *   - 布局符合 Multiboot 规范，同时保持内核代码的独立性
 */

/* ------------------------------------------------------------
 * 入口点（Entry Point）
 * ------------------------------------------------------------
 * ENTRY 指定程序开始执行的符号（函数名）
 * _start 是内核的入口点，由汇编或 Rust 的 #[no_mangle] 函数定义
 * 
 * 注意：AXIS 内核使用 _start 作为引导加载程序（如 GRUB）跳转的入口
 *       该函数必须：
 *       1. 使用全局可见性（pub extern "C" fn _start()）
 *       2. 不能依赖任何标准库初始化（裸机环境）
 *       3. 执行必要的早期初始化（如设置栈指针、清零 BSS、启用分页等）
 *       4. 最终跳转到内核的 Rust 入口（如 kernel_main）
 */
ENTRY(_start)

/* ------------------------------------------------------------
 * 段（Sections）布局定义
 * ------------------------------------------------------------
 * SECTIONS 块定义了各个段在内存中的位置和排列顺序
 * 所有地址都是相对于最终加载地址（由 Multiboot 加载器决定）
 */
SECTIONS
{
    /* 设置当前地址计数器（Location Counter）为 1MB
     * . = 1M; 表示将所有段放置在物理内存的 1MB 起始位置
     * 原因：x86 架构中，1MB 以下是传统 BIOS 区域（如 VGA 显存、BIOS 数据等）
     *       1MB 以上是常规内存区域，适合放置引导程序
     * 对于 Multiboot 兼容的引导程序，内核通常加载到 1MB 以上
     */
    . = 1M;

    /* ========================================================
     * .boot - 引导段（Boot Section）
     * ========================================================
     * 该段包含 Multiboot 头部，必须位于内核文件的最开头
     * 
     * 为什么命名为 .boot 而不是 .multiboot_header？
     *   - 明确表示该段属于引导阶段
     *   - 可以包含其他引导相关的元数据（如需扩展）
     * 
     * KEEP() 强制保留该段，即使 Rust 编译器认为它未被引用* 
     * *(.multiboot_header) 匹配所有输入目标文件中该段：
     *   - 该段在 Rust/汇编代码中定义
     *   - 包含引导程序（GRUB）识别所需的魔数、标志位和校验和
     *   - 满足 Multiboot 规范：头部必须在文件前 8KB 或 4 字节对齐内
     * 
     * 位置的关键性：
     *   - 此段必须放在 .text 之前，确保它位于文件最前面
     *   - 某些 Multiboot 加载器要求头部在文件开头 8KB 范围内
     *   - 使用 .boot 作为段名明确其特殊性质
     */
    .boot :
    {
        KEEP(*(.multiboot_header))
    }

    /* ========================================================
     * .text - 代码段（只读、可执行）
     * ========================================================
     * ALIGN(4K) 将段起始地址对齐到 4KB 边界
     * 4KB 是 x86_64 的分页大小，对齐有利于内存管理和缓存效率
     * 
     * *(.text .text.*) 匹配所有 .text 开头的段：
     *   - .text 包含所有函数代码（Rust、汇编、内联汇编）
     *   - .text.* 匹配 LLVM 生成的带后缀的段
     *   - 后缀格式通常为 .text._ZN...（Rust 符号修饰）
     *   - 包括内核的所有执行代码
     * 
     * 注意：代码段在运行时是只读的，操作系统/内核必须保护它不被修改
     */
    .text : ALIGN(4K)
    {
        *(.text .text.*)
    }

    /* ========================================================
     * .rodata - 只读数据段（只读、不可执行）
     * ========================================================
     * 存放常量数据：
     *   - 字符串字面量（"Hello, World!" 等）
     *   - 静态常量（const 变量）
     *   - 虚表（vtable，用于 trait 对象的动态分发）
     *   - 编译时确定的查找表（如 Unicode 映射表）
     *   - 内核的 GDT/IDT 描述符等只读数据结构
     * 
     * 对齐到 4KB 边界：
     *   - 与分页大小保持一致
     *   - 便于 MMU 设置只读权限（整个页只读）
     * 
     * 安全性考虑：
     *   - 该段在运行时不可修改，防止代码注入或数据篡改
     *   - 内核应尽量将常量数据放在只读区域
     */
    .rodata : ALIGN(4K)
    {
        *(.rodata .rodata.*)
    }

    /* ========================================================
     * .data - 已初始化数据段（可读写）
     * ========================================================
     * 存放已初始化的全局变量和静态变量：
     *   - 静态变量（static mut 或 static 有初始值）
     *   - 全局分配器（allocator）的元数据
     *   - 内核配置参数（如启动参数、硬件配置）
     *   - 设备驱动中的状态变量
     * 
     * 该段在二进制文件中占用空间：
     *   - 初始值直接嵌入在 ELF 文件中
     *   - 由引导程序或加载器复制到内存指定位置
     *   - 运行时可以读写修改
     * 
     * 对齐到 4KB 边界便于内存管理
     */
    .data : ALIGN(4K)
    {
        *(.data .data.*)
    }

    /* ========================================================
     * .bss - 未初始化数据段（可读写，初始值为零）
     * ========================================================
     * BSS（Block Started by Symbol）段：
     *   - 存放未初始化的全局/静态变量
     *   - 这些变量在程序启动时应该被清零
     *   - 二进制文件中不占用存储空间（只记录大小）
     *   - 节省磁盘空间和启动加载时间
     * 
     * 典型的 BSS 数据：
     *   - 栈空间（内核栈）
     *   - 堆空间（内存分配器的空闲区域）
     *   - 大型数据结构（如页表、进程控制块）
     *   - 未初始化的静态缓冲区
     * 
     * *(COMMON) 匹配通用符号：
     *   - 这些是 C 语言中未初始化的全局变量（Rust 通常不会生成）
     *   - 保留以确保兼容性和完整性
     * 
     * 关键操作：
     *   - 内核必须在启动时手动清零此区域
     *   - 可通过汇编指令（rep stosq）或 Rust 的 core::ptr::write_bytes 实现
     *   - 清零操作在启用分页之前或之后执行（取决于设计）
     *   - 未清零的 BSS 会导致未定义行为（如指针解引用错误）
     */
    .bss : ALIGN(4K)
    {
        *(.bss .bss.*)
        *(COMMON)
    }

    /* ========================================================
     * /DISCARD/ - 丢弃不需要的段
     * ========================================================
     * 这些段在最终二进制文件中被完全移除，不占用空间
     * 
     * .eh_frame: 异常处理帧信息
     *   - 用于 C++ 的 unwinding（栈展开）
     *   - Rust 在裸机环境中不使用异常处理（panic = abort）
     *   - 移除可减小二进制体积（通常数千字节）
     * 
     * .note .note.*: ELF 注释段
     *   - 包含 ABI 版本、编译器信息、版权声明等元数据
     *   - 对内核运行无关紧要，可以安全丢弃以减小体积
     *   - 注意：某些调试器可能需要这些信息，但生产环境中不需要
     */
    /DISCARD/ :
    {
        *(.eh_frame)
        *(.note .note.*)
    }
}

/* ============================================================
 * 补充说明：
 * 
 * 1. 内核加载流程：
 *    - GRUB 加载内核 ELF 文件到 1MB 地址
 *    - GRUB 根据 Multiboot 头部验证并跳转到 _start
 *    - _start（汇编）设置临时栈，清零 BSS，启用分页
 *    - _start 跳转到 Rust 的 kmain() 或 kernel_main()
 *    - 内核初始化完成，开始调度和执行用户程序
 * 
 * 2. 内存布局特点：
 *    - 所有段紧密排列，从 1MB 开始连续放置
 *    - 段之间以 4KB 对齐，便于分页管理
 *    - 内核代码和数据整体占用连续物理内存
 *    - 后续可通过分页将内核映射到高地址（Higher Half Kernel）
 * 
 * 3. 与标准 x86_64-unknown-none 目标的区别：
 *    - 标准目标有预定义的链接器脚本
 *    - 自定义脚本允许精细控制内存布局
 *    - 本脚本针对 AXIS 内核特定需求优化
 *    - 可根据内核设计调整段顺序和大小
 * ============================================================
 */
