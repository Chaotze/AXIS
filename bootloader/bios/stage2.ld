/* ============================================================
 * BIOS Stage2 链接脚本
 * ============================================================
 * 定义 Stage2 的内存布局和链接规则
 *
 * Stage2 加载地址：0x7e00（紧随 MBR 之后）
 * 目标：将汇编代码和 Rust 代码正确链接在一起
 */

/* 输出格式：纯二进制（不是 ELF） */
OUTPUT_FORMAT(binary)

/* 入口点：stage2_entry（Stage2 汇编代码的入口） */
ENTRY(stage2_entry)

/* ------------------------------------------------------------
 * 段（Sections）布局定义
 * ------------------------------------------------------------
 * SECTIONS 块定义了各个段在内存中的位置和排列顺序
 * 所有地址都是相对于最终加载地址（通常由目标平台决定）
 */
SECTIONS
{
    /* 起始地址：Stage1 将 Stage2 加载到 0x7e00 */
    . = 0x7e00;

    /* ========================================================
     * .text - 代码段：包含汇编和 Rust 代码（只读、可执行）
     * ========================================================
     * 4KB 是 x86_64 的分页大小，对齐有利于内存管理和缓存效率
     * 
     * *(.text .text.*) 匹配所有 .text 开头的段
     * 包含所有函数代码（Rust 的 .text 段、汇编代码等）
     * .text.* 用于匹配 LLVM 生成的带后缀的段（如 .text._ZN...）
     */
    .text : {
        /* 首先放置汇编入口代码 */
        *(.text.stage2_entry)

        /* 然后放置其他汇编代码 */
        *(.text)

        /* Rust 代码 */
        *(.text.*)
    }

    /* ========================================================
     * .rodata - 只读数据段：字符串常量等（只读、不可执行）
     * ========================================================
     * 存放常量数据：字符串字面量、静态常量、虚表（vtable）等
     * 该段在运行时不可修改，通常位于只读内存区域
     */
    .rodata : ALIGN(4) {
        *(.rodata)
        *(.rodata.*)
    }

    /* ========================================================
     * .data - 已初始化数据段：全局变量、静态变量等（可读写）
     * ========================================================
     * 存放已初始化的全局变量和静态变量
     * 这些变量在程序启动时已有初始值，由操作系统或引导程序加载器负责初始化
     * 在裸机环境中，这些初始值直接嵌入在二进制文件中
     */
    .data : ALIGN(4) {
        *(.data)
        *(.data.*)
    }

    /* ========================================================
     * .bss - 未初始化数据段：未初始化的全局变量（可读写，初始值为零）
     * ========================================================
     * BSS（Block Started by Symbol）段存放未初始化的全局/静态变量
     * 这些变量在程序启动时应该被清零，但二进制文件中不占用存储空间
     * 引导程序必须在运行时手动清零此区域（通过汇编或 Rust 代码）
     * 
     * *(COMMON) 匹配通用符号（common symbols），这些是未初始化的全局变量
     * 由于 Rust 通常不会生成 COMMON 符号，但保留以兼容其他语言
     * 
     * 为什么需要对齐？
     *   - BSS 段在运行时需要被清零
     *   - 对齐可以使用高效的批量清零指令（如 rep stosd）
     */
    .bss : ALIGN(4) {
        __bss_start = .;
        *(.bss)
        *(.bss.*)
        *(COMMON)
        __bss_end = .;
    }

    /* ========================================================
     * /DISCARD/ - 丢弃不需要的段
     * ========================================================
     * 这些段在最终二进制文件中被完全移除，不占用空间
     * 
     * 为什么丢弃？
     *   - 引导加载程序需要精简，不需要调试符号
     *   - 减小二进制体积，加快加载速度
     */
    /DISCARD/ : {
        *(.eh_frame)        /* 异常处理帧（栈展开信息） */
        *(.comment)         /* 编译器注释 */
        *(.note*)           /* 注释段 */
    }
}
